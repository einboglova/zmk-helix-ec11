/*
 * Copyright (c) 2020 The ZMK Contributors
 *
 * SPDX-License-Identifier: MIT
 */

#include "helix.dtsi"

&default_transform {
    col-offset = <7>;
};
    
right_encoder: right_encoder {
        compatible = "alps,ec11";
        steps = <80>;

        a-gpios = <&pro_micro 9 (GPIO_ACTIVE_HIGH )>;    
        b-gpios = <&pro_micro 10 (GPIO_ACTIVE_HIGH )>;    
};
sensors {
        compatible = "zmk,keymap-sensors";
        sensors = <&left_encoder &right_encoder>;
        triggers-per-rotation = <20>;
    };
};
&right_encoder {
    status = "okay";
};


&kscan0 {
    col-gpios
        = <&pro_micro 16 GPIO_ACTIVE_HIGH>
        , <&pro_micro 14 GPIO_ACTIVE_HIGH>
        , <&pro_micro 15 GPIO_ACTIVE_HIGH>
        , <&pro_micro 18 GPIO_ACTIVE_HIGH>
        , <&pro_micro 19 GPIO_ACTIVE_HIGH>
        , <&pro_micro 20 GPIO_ACTIVE_HIGH>
        , <&pro_micro 21 GPIO_ACTIVE_HIGH>
        ;
};
